## build/conf/bblayers.conf
```bitbake
# LAYER_CONF_VERSION is increased each time build/conf/bblayers.conf
# changes incompatibly
LCONF_VERSION = "8"

BBPATH = "${TOPDIR}"
BBFILES ?= ""

BBLAYERS ?= " \
  /home/henry/openbmc/meta \
  /home/henry/openbmc/meta-openembedded/meta-oe \
  /home/henry/openbmc/meta-openembedded/meta-networking \
  /home/henry/openbmc/meta-openembedded/meta-perl \
  /home/henry/openbmc/meta-openembedded/meta-python \
  /home/henry/openbmc/meta-phosphor \
  /home/henry/openbmc/meta-aspeed \
  /home/henry/openbmc/meta-openpower \
  /home/henry/openbmc/meta-ibm/meta-romulus \
  /home/henry/openbmc/meta-ibm/meta-henry \
  "
```

## meta-henry/conf/layer.conf
```bitbake
BBPATH .= ":${LAYERDIR}"

BBFILES += "${LAYERDIR}/recipes-*/*/*.bb \
            ${LAYERDIR}/recipes-*/*/*.bbappend"

BBFILE_COLLECTIONS += "meta-henry"
BBFILE_PATTERN_meta-henry = "^${LAYERDIR}/"
BBFILE_PRIORITY_meta-henry = "6"

LAYERSERIES_COMPAT_meta-henry = "whinlatter"
```
